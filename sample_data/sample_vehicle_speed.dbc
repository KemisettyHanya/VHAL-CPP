VERSION ""

NS_ :

BS_:

BU_: VehicleECU AndroidVHAL Tester

BO_ 256 VehicleSpeedMsg: 8 VehicleECU
 SG_ VehicleSpeed : 0|16@1+ (0.01,0) [0|300] "km/h" AndroidVHAL
 SG_ VehicleSpeedStatus : 16|8@1+ (1,0) [0|3] "" AndroidVHAL

BO_ 257 EngineData: 8 VehicleECU
 SG_ EngineSpeed : 0|16@1+ (0.25,0) [0|8000] "rpm" AndroidVHAL
 SG_ EngineTorque : 16|16@1+ (0.1,-500) [-500|1500] "Nm" AndroidVHAL

CM_ BO_ 256 "Standard vehicle speed transmission message";
CM_ SG_ 256 VehicleSpeed "Current vehicle ground speed in km/h with 0.01 resolution";
CM_ SG_ 256 VehicleSpeedStatus "Vehicle speed calculation status enum";
CM_ BO_ 257 "Powertrain engine operating parameters";
CM_ SG_ 257 EngineSpeed "Engine rotational speed in RPM with 0.25 resolution";
CM_ SG_ 257 EngineTorque "Engine output torque in Nm";

VAL_ 256 VehicleSpeedStatus 0 "OK" 1 "Degraded" 2 "Fault" 3 "Unavailable" ;
